## snakeware/external/package/python-xonsh/Config.in
```kconfig
config BR2_PACKAGE_PYTHON_XONSH
	bool "python-xonsh"
	help
	  Python-powered, cross-platform, Unix-gazing shell.

	  https://github.com/xonsh/xonsh
	select BR2_PACKAGE_PYTHON_PROMPT_TOOLKIT
	select BR2_PACKAGE_PYTHON_PYGMENTS
	select BR2_PACKAGE_PYTHON_SETPROCTITLE
```

## snakeware/external/package/xonsh/Config.in
```kconfig
config BR2_PACKAGE_XONSH
	bool "xonsh"
	help
	  xonsh is a Python-powered, cross-platform, Unix-gazing shell language and command prompt.

	  https://xon.sh/
	select BR2_PACKAGE_PYTHON_SETPROCTITLE
	select BR2_PACKAGE_PYTHON_PROMPT_TOOLKIT
	select BR2_PACKAGE_PYTHON_PYGMENTS
```
